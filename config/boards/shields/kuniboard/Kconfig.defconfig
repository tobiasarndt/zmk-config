## config/boards/shields/kuniboard/Kconfig.defconfig
```kconfig
# Copyright (c) 2024 ZMK
# SPDX-License-Identifier: MIT

if SHIELD_KUNIBOARD_LEFT

config ZMK_KEYBOARD_NAME
	default "Kuniboard"

config ZMK_SPLIT_ROLE_CENTRAL
	default y

config ZMK_DISPLAY
	select LV_FONT_MONTSERRAT_28

if ZMK_DISPLAY

config SPI
	default y

config LS0XX
	default y
endif # ZMK_DISPLAY
endif

if SHIELD_KUNIBOARD_LEFT || SHIELD_KUNIBOARD_RIGHT

config ZMK_SPLIT
	default y

endif

config KUNIBOARD_CUSTOM_DISPLAY
    bool "use custom kuniboard display"

if KUNIBOARD_CUSTOM_DISPLAY

    config CONFIG_KUNIBOARD_SCREEN_INVERTED
        bool "invert kuniboard display color"

    choice ZMK_DISPLAY_STATUS_SCREEN
        default ZMK_DISPLAY_STATUS_SCREEN_CUSTOM
    endchoice

    config ZMK_SPLIT_BLE_CENTRAL_BATTERY_LEVEL_FETCHING
        default y

    config ZMK_DISPLAY_STATUS_SCREEN_CUSTOM
        select LV_USE_LABEL
        select LV_USE_IMG
        select LV_USE_CANVAS
        select LV_USE_ANIMIMG 
        select LV_USE_ANIMATION
        select LV_USE_LINE 
        select LV_FONT_UNSCII_8
    	select LV_FONT_MONTSERRAT_16
    	select LV_FONT_MONTSERRAT_12
        imply ZMK_HID_INDICATORS

    choice ZMK_DISPLAY_WORK_QUEUE
        default ZMK_DISPLAY_WORK_QUEUE_DEDICATED
    endchoice

    config LV_Z_MEM_POOL_SIZE
        default 4096

    config LV_Z_VDB_SIZE
        default 100

    config LV_DPI_DEF
        default 161

    config LV_Z_BITS_PER_PIXEL
        default 1

    choice LV_COLOR_DEPTH
        default LV_COLOR_DEPTH_1
    endchoice

endif
```

## config/boards/shields/kuniboard/Kconfig.shield
```kconfig
# Copyright (c) 2024 ZMK
# SPDX-License-Identifier: MIT

config SHIELD_KUNIBOARD_LEFT
	def_bool $(shields_list_contains,kuniboard_left)

config SHIELD_KUNIBOARD_RIGHT
	def_bool $(shields_list_contains,kuniboard_right)
```

## config/west.yml
```yaml
manifest:
  remotes:
    - name: zmkfirmware
      url-base: https://github.com/hookyKB
    # Additional modules containing boards/shields/custom code can be listed here as well
    # See https://docs.zephyrproject.org/3.2.0/develop/west/manifest.html#projects
  projects:
    - name: zmk
      remote: zmkfirmware
      revision: 7c2ad3db5fcd9c6fead00df8a94b859aa556f71b
      import: app/west.yml
  self:
    path: config
```

## kuniboard_display/app/boards/shield/kuniboard_display/custom_display/widgets/Kconfig.defconfig
```kconfig
# Copyright (c) 2020 The ZMK Contributors
# SPDX-License-Identifier: MIT

menu "ZMK Display Widgets"

config ZMK_WIDGET_LAYER_STATUS
    bool "Widget for highest, active layer using small icons"
    depends on !ZMK_SPLIT || ZMK_SPLIT_ROLE_CENTRAL
    select LV_USE_LABEL
    select LV_FONT_MONTSERRAT_16
    select LV_FONT_MONTSERRAT_14
    select LV_FONT_UNSCII_16
    select LV_USE_CANVAS

config ZMK_WIDGET_BATTERY_STATUS
    bool "Widget for battery charge information, using small icons"
    depends on BT
    select LV_USE_LABEL

if ZMK_WIDGET_BATTERY_STATUS

config ZMK_WIDGET_BATTERY_STATUS_SHOW_PERCENTAGE
    bool "Show battery level percentage in text"

endif

config ZMK_WIDGET_OUTPUT_STATUS
    bool "Widget for keyboard output status icons"
    depends on BT && (!ZMK_SPLIT_BLE || ZMK_SPLIT_ROLE_CENTRAL)
    select LV_USE_LABEL

config ZMK_WIDGET_PERIPHERAL_STATUS
    bool "Widget for split peripheral status icons"
    depends on BT && ZMK_SPLIT_BLE && !ZMK_SPLIT_ROLE_CENTRAL
    select LV_USE_LABEL

config ZMK_WIDGET_WPM_STATUS
    bool "Widget for displaying typed words per minute"
    depends on !ZMK_SPLIT || ZMK_SPLIT_ROLE_CENTRAL
    select LV_USE_LABEL
    select ZMK_WPM

config ZMK_WIDGET_SLEEP_STATUS
    bool "Widget for sleep screens"
    depends on !ZMK_SPLIT || ZMK_SPLIT_ROLE_CENTRAL
    select LV_USE_IMG

endmenu
```
