
&display_spi {
	status = "okay";
	sharp: ls0xx@0 {
		compatible = "sharp,ls0xx";
		label = "DISPLAY";
		spi-max-frequency = <2000000>;
		reg = <0>;
		width = <160>;
		height = <68>;
	};
};

/ {
  chosen {
    zephyr,display = &sharp;
  };
};